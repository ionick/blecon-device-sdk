## examples/zephyr/memfault/sysbuild/mcuboot/boards/k7p54l_nrf54l15_cpuapp.conf
```kconfig
# Copyright (c) Blecon Ltd
# SPDX-License-Identifier: Apache-2.0

CONFIG_MULTITHREADING=y
CONFIG_PM_OVERRIDE_EXTERNAL_DRIVER_CHECK=y
```
